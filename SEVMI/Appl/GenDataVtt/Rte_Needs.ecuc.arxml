AUTOSAR XML (schema 4-0-3)
package /DaVinci_Project
  module config Com
    ComConfig
      6 x ComSignal:
        sig_BatteryStatus_Out: ComSignalType=UINT16
        sig_Ignition_In: ComSignalType=BOOLEAN
        sig_Locking_In: ComSignalType=BOOLEAN
        sig_SolarPanelSwitch_In: ComSignalType=BOOLEAN
        sig_SpeedLimit_Out: ComSignalType=UINT16
        sig_SunlightPresence_In: ComSignalType=UINT16
  module config Rte
    17 x RteBswModuleInstance:
      BswM
        BswM_MainFunctionTimingEvent0 (RteBswEventToTaskMapping): RteBswUsedOsEventRef=Rte_Ev_Cyclic2_SchM_Task_0_10ms, RteBswUsedOsAlarmRef=Os/Rte_Al_TE2_SchM_Task_0_10ms
      Can
        3 x RteBswEventToTaskMapping, all with RteBswUsedOsEventRef=Rte_Ev_Cyclic2_SchM_Task_0_10ms, RteBswUsedOsAlarmRef=Os/Rte_Al_TE2_SchM_Task_0_10ms:
          Can_MainFunction_BusOffTimingEvent0
          Can_MainFunction_ModeTimingEvent0
          Can_MainFunction_WakeupTimingEvent0
      CanIf
      CanNm
        CanNm_MainFunctionTimingEvent0 (RteBswEventToTaskMapping): RteBswUsedOsEventRef=Rte_Ev_Cyclic2_SchM_Task_0_10ms, RteBswUsedOsAlarmRef=Os/Rte_Al_TE2_SchM_Task_0_10ms
      CanSM
        CanSM_MainFunctionTimingEvent0 (RteBswEventToTaskMapping): RteBswUsedOsEventRef=Rte_Ev_Cyclic2_SchM_Task_0_10ms, RteBswUsedOsAlarmRef=Os/Rte_Al_TE2_SchM_Task_0_10ms
      CanTp
        CanTp_MainFunctionTimingEvent0 (RteBswEventToTaskMapping): RteBswUsedOsEventRef=Rte_Ev_Cyclic2_SchM_Task_0_5ms, RteBswUsedOsAlarmRef=Os/Rte_Al_TE2_SchM_Task_0_5ms
      Com
        Com_MainFunctionRxTimingEvent0 (RteBswEventToTaskMapping): RteBswUsedOsEventRef=Rte_Ev_Cyclic2_SchM_Task_0_10ms, RteBswUsedOsAlarmRef=Os/Rte_Al_TE2_SchM_Task_0_10ms
        Com_MainFunctionTxTimingEvent0 (RteBswEventToTaskMapping): RteBswUsedOsEventRef=Rte_Ev_Cyclic2_SchM_Task_0_10ms, RteBswUsedOsAlarmRef=Os/Rte_Al_TE2_SchM_Task_0_10ms
      ComM
        ComM_MainFunction_0TimingEvent0 (RteBswEventToTaskMapping): RteBswUsedOsEventRef=Rte_Ev_Cyclic2_SchM_Task_0_20ms, RteBswUsedOsAlarmRef=Os/Rte_Al_TE2_SchM_Task_0_20ms
      Dcm
        Dcm_MainFunctionTimingEvent0 (RteBswEventToTaskMapping): RteBswUsedOsEventRef=Rte_Ev_Cyclic2_SchM_Task_0_10ms, RteBswUsedOsAlarmRef=Os/Rte_Al_TE2_SchM_Task_0_10ms
      Dem
        Dem_MainFunctionTimingEvent0 (RteBswEventToTaskMapping): RteBswUsedOsEventRef=Rte_Ev_Cyclic2_SchM_Task_0_10ms, RteBswUsedOsAlarmRef=Os/Rte_Al_TE2_SchM_Task_0_10ms
      Det
      EcuM
        EcuM_MainFunctionTimingEvent0 (RteBswEventToTaskMapping): RteBswUsedOsEventRef=Rte_Ev_Cyclic2_SchM_Task_0_10ms, RteBswUsedOsAlarmRef=Os/Rte_Al_TE2_SchM_Task_0_10ms
      Fee
        Fee_MainFunctionTimingEvent0 (RteBswEventToTaskMapping): RteBswUsedOsEventRef=Rte_Ev_Cyclic2_SchM_Task_0_5ms, RteBswUsedOsAlarmRef=Os/Rte_Al_TE2_SchM_Task_0_5ms
      Fls
        Fls_MainFunctionTimingEvent0 (RteBswEventToTaskMapping): RteBswUsedOsEventRef=Rte_Ev_Cyclic2_SchM_Task_0_10ms, RteBswUsedOsAlarmRef=Os/Rte_Al_TE2_SchM_Task_0_10ms
      Nm
      NvM
        NvM_MainFunctionTimingEvent0 (RteBswEventToTaskMapping): RteBswUsedOsEventRef=Rte_Ev_Cyclic2_SchM_Task_0_10ms, RteBswUsedOsAlarmRef=Os/Rte_Al_TE2_SchM_Task_0_10ms
      PduR
    16 x RteSwComponentInstance:
      BswM_EcuSwComposition
        Timer_BswM_MainFunction (RteEventToTaskMapping): RteUsedOsEventRef=Rte_Ev_Cyclic2_SchM_Task_0_10ms, RteUsedOsAlarmRef=Os/Rte_Al_TE2_SchM_Task_0_10ms
      ComM_EcuSwComposition
        Timer_ComM_MainFunction_0 (RteEventToTaskMapping): RteUsedOsEventRef=Rte_Ev_Cyclic2_SchM_Task_0_20ms, RteUsedOsAlarmRef=Os/Rte_Al_TE2_SchM_Task_0_20ms
      CpApSEVMIController_EcuSwComposition
        TMT_RCtApSEVMI (RteEventToTaskMapping): RteUsedOsEventRef=Rte_Ev_Run_CpApSEVMIController_RCtApSEVMI, RteUsedOsAlarmRef=Os/Rte_Al_TE_CpApSEVMIController_RCtApSEVMI
        MST_RCtBatteryMode_0 (RteEventToTaskMapping): RteUsedOsEventRef=Rte_Ev_Run_CpApSEVMIController_RCtBatteryMode
        NvmBlock_CpApSEVMIController_SnNvMPimDoorLock (RteNvRamAllocation): RteNvmRamBlockLocationSymbol=Rte_CpApSEVMIController_SnNvMPimDoorLock_MirrorBlock, RteNvmBlockRef=CpApSEVMIControllerSnNvMPimDoorLock
      CtIoHwAb_EcuSwComposition
        OIT_PpSpeed_ReadChannelHwAb_PpSpeed_ReadChannel (RteEventToTaskMapping): RteUsedOsEventRef=Rte_Ev_Run_CpIoHwAb_PpSpeed_ReadChannelHwAb
      CpSaEngineControl_EcuSwComposition
        TMT_RIgnition (RteEventToTaskMapping): RteUsedOsEventRef=Rte_Ev_Cyclic_IO_Task_0_100ms, RteUsedOsAlarmRef=Os/Rte_Al_TE_IO_Task_0_100ms
      CpSaLockControl_EcuSwComposition
        TMT_RLock (RteEventToTaskMapping): RteUsedOsEventRef=Rte_Ev_Cyclic_IO_Task_0_100ms, RteUsedOsAlarmRef=Os/Rte_Al_TE_IO_Task_0_100ms
      CpSaSolarPanelControl_EcuSwComposition
        TMT_RCharging (RteEventToTaskMapping): RteUsedOsEventRef=Rte_Ev_Cyclic_IO_Task_0_100ms, RteUsedOsAlarmRef=Os/Rte_Al_TE_IO_Task_0_100ms
      CpSaSpeedLimit_EcuSwComposition
        DRT_RSpeedLimit_PpSpeedLimit_DeSpeedLimit (RteEventToTaskMapping): RteUsedOsEventRef=Rte_Ev_Run_CpSaSpeedLimit_RSpeedLimit
      CpSaSunlightPresence_EcuSwComposition
        TMT_RSunlight (RteEventToTaskMapping): RteUsedOsEventRef=Rte_Ev_Cyclic_IO_Task_0_100ms, RteUsedOsAlarmRef=Os/Rte_Al_TE_IO_Task_0_100ms
      CtSaBatteryManagement_EcuSwComposition
        DRT_RBatteryStatus_PpBatteryStatus_DeBatteryStatus (RteEventToTaskMapping): RteUsedOsEventRef=Rte_Ev_Run_CtSaBattery_RBatteryStatus
      CtSaBatteryModeManager_EcuSwComposition
        TMT_RCtApBatteryManager_WriteMode (RteEventToTaskMapping): RteUsedOsEventRef=Rte_Ev_Cyclic_IO_Task_0_100ms, RteUsedOsAlarmRef=Os/Rte_Al_TE_IO_Task_0_100ms
      Dcm_EcuSwComposition
        Timer_Dcm_MainFunction (RteEventToTaskMapping): RteUsedOsEventRef=Rte_Ev_Cyclic2_SchM_Task_0_10ms, RteUsedOsAlarmRef=Os/Rte_Al_TE2_SchM_Task_0_10ms
      Dem_EcuSwComposition
        Timer_Dem_MainFunction (RteEventToTaskMapping): RteUsedOsEventRef=Rte_Ev_Cyclic2_SchM_Task_0_10ms, RteUsedOsAlarmRef=Os/Rte_Al_TE2_SchM_Task_0_10ms
      Det_EcuSwComposition
      EcuM_EcuSwComposition
        Timer_EcuM_MainFunction (RteEventToTaskMapping): RteUsedOsEventRef=Rte_Ev_Cyclic2_SchM_Task_0_10ms, RteUsedOsAlarmRef=Os/Rte_Al_TE2_SchM_Task_0_10ms
      NvM_EcuSwComposition
        Timer_NvM_MainFunction (RteEventToTaskMapping): RteUsedOsEventRef=Rte_Ev_Cyclic2_SchM_Task_0_10ms, RteUsedOsAlarmRef=Os/Rte_Al_TE2_SchM_Task_0_10ms
    RteOsInteraction
      5 x RteUsedOsActivation, all with RteExpectedActivationOffset=0:
        Rte_Al_TE_IO_Task_0_100ms: RteActivationOsAlarmRef=Os/Rte_Al_TE_IO_Task_0_100ms, RteActivationOsTaskRef=IO_Task
        Rte_Al_TE_CpApSEVMIController_RCtApSEVMI: RteActivationOsAlarmRef=Os/Rte_Al_TE_CpApSEVMIController_RCtApSEVMI, RteActivationOsTaskRef=My_Task
        Rte_Al_TE2_SchM_Task_0_10ms: RteActivationOsAlarmRef=Os/Rte_Al_TE2_SchM_Task_0_10ms, RteActivationOsTaskRef=SchM_Task
        Rte_Al_TE2_SchM_Task_0_20ms: RteActivationOsAlarmRef=Os/Rte_Al_TE2_SchM_Task_0_20ms, RteActivationOsTaskRef=SchM_Task
        Rte_Al_TE2_SchM_Task_0_5ms: RteActivationOsAlarmRef=Os/Rte_Al_TE2_SchM_Task_0_5ms, RteActivationOsTaskRef=SchM_Task
  module config NvM
    CpApSEVMIControllerSnNvMPimDoorLock (NvMBlockDescriptor): NvMNvBlockLength=1, NvMRamBlockDataAddress=Rte_CpApSEVMIController_SnNvMPimDoorLock_MirrorBlock, NvMRomBlockDataAddress=NULL_PTR
  module config Os
    IO_Task (OsTask):
      OsTaskActivation = 1
      OsTaskPriority = 3
      OsTaskSchedule = FULL
      OsTaskEventRef = Rte_Ev_Cyclic_IO_Task_0_100ms
      OsTaskEventRef = Rte_Ev_Run_CpIoHwAb_PpSpeed_ReadChannelHwAb
      OsTaskEventRef = Rte_Ev_Run_CpSaSpeedLimit_RSpeedLimit
      OsTaskEventRef = Rte_Ev_Run_CtSaBattery_RBatteryStatus
    Rte_Al_TE_IO_Task_0_100ms (OsAlarm): OsAlarmCounterRef=SystemTimer
      OsAlarmAction
        OsAlarmSetEvent: OsAlarmSetEventRef=Rte_Ev_Cyclic_IO_Task_0_100ms, OsAlarmSetEventTaskRef=IO_Task
    My_Task (OsTask):
      OsTaskActivation = 1
      OsTaskPriority = 2
      OsTaskSchedule = FULL
      OsTaskEventRef = Rte_Ev_Run_CpApSEVMIController_RCtApSEVMI
      OsTaskEventRef = Rte_Ev_Run_CpApSEVMIController_RCtBatteryMode
    Rte_Al_TE_CpApSEVMIController_RCtApSEVMI (OsAlarm): OsAlarmCounterRef=SystemTimer
      OsAlarmAction
        OsAlarmSetEvent: OsAlarmSetEventRef=Rte_Ev_Run_CpApSEVMIController_RCtApSEVMI, OsAlarmSetEventTaskRef=My_Task
    SchM_Task (OsTask):
      OsTaskActivation = 1
      OsTaskPriority = 6
      OsTaskSchedule = FULL
      OsTaskEventRef = Rte_Ev_Cyclic2_SchM_Task_0_10ms
      OsTaskEventRef = Rte_Ev_Cyclic2_SchM_Task_0_20ms
      OsTaskEventRef = Rte_Ev_Cyclic2_SchM_Task_0_5ms
    3 x OsAlarm, all with OsAlarmCounterRef=SystemTimer:
      Rte_Al_TE2_SchM_Task_0_10ms
        OsAlarmAction
          OsAlarmSetEvent: OsAlarmSetEventRef=Rte_Ev_Cyclic2_SchM_Task_0_10ms, OsAlarmSetEventTaskRef=SchM_Task
      Rte_Al_TE2_SchM_Task_0_20ms
        OsAlarmAction
          OsAlarmSetEvent: OsAlarmSetEventRef=Rte_Ev_Cyclic2_SchM_Task_0_20ms, OsAlarmSetEventTaskRef=SchM_Task
      Rte_Al_TE2_SchM_Task_0_5ms
        OsAlarmAction
          OsAlarmSetEvent: OsAlarmSetEventRef=Rte_Ev_Cyclic2_SchM_Task_0_5ms, OsAlarmSetEventTaskRef=SchM_Task
    9 x OsEvent:
      Rte_Ev_Cyclic2_SchM_Task_0_10ms
      Rte_Ev_Cyclic2_SchM_Task_0_20ms
      Rte_Ev_Cyclic2_SchM_Task_0_5ms
      Rte_Ev_Cyclic_IO_Task_0_100ms
      Rte_Ev_Run_CpApSEVMIController_RCtApSEVMI
      Rte_Ev_Run_CpApSEVMIController_RCtBatteryMode
      Rte_Ev_Run_CpIoHwAb_PpSpeed_ReadChannelHwAb
      Rte_Ev_Run_CpSaSpeedLimit_RSpeedLimit
      Rte_Ev_Run_CtSaBattery_RBatteryStatus
  ecuc value collection DaVinci_Project: ecuc-values=[Com, Rte, Os, NvM]
