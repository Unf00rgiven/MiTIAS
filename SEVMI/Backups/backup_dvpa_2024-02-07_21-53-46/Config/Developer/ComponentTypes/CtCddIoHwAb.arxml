AUTOSAR XML (schema 4-2-1)
package /ComponentTypes
  complex device driver sw component type CtCddIoHwAb
    behavior CtCddIoHwAb_InternalBehavior
      runnable RCtCddIoHwAb_PpAFSSwitch_ReadChannel
      runnable RCtCddIoHwAb_PpHighBeam_ReadChannel
  swc implementation CtCddIoHwAb_Implementation: behavior=CtCddIoHwAb_InternalBehavior
    code-descriptors:
      code Default: artifact-descriptors=autosar-engineering-object={short-label=Default, category=SWSRC}
