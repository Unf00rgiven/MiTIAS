AUTOSAR XML (schema 4-2-1)
package /ComponentTypes
  sensor actuator sw component type CtSaSteeringWheel
    behavior CtSaSteeringWheel_InternalBehavior
      timing event TMT_RCtSaSteeringWheelGetPosition: start-on-event=RCtSaSteeringWheelGetPosition, period=0.1
      runnable RCtSaSteeringWheelGetPosition
  swc implementation CtSaSteeringWheel_Implementation: behavior=CtSaSteeringWheel_InternalBehavior
    code-descriptors:
      code Default: artifact-descriptors=autosar-engineering-object={short-label=Default, category=SWSRC}
