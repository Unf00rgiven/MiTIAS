AUTOSAR XML (schema 4-2-1)
package /Constants
  14 x constant specification:
    CAFSSwitchOff: value-spec=0
    CAngleZero: value-spec=0
    CBatteryStatus: value-spec=70
    CCarLocked: value-spec=0
    CCharging: value-spec=0
    CDarkLight: value-spec=0
    CHeadlightControlInit: value-spec=fields=[HorizontalAngle:0, Mode:0]
    CHeadlightInitMode: value-spec=0
    CHighBeamSwitchOff: value-spec=0
    CIgnition: value-spec=0
    CInitSpeed: value-spec=0
    CSpeedLimit: value-spec=180
    CSteeringWheelInitPosition: value-spec=0
    CSunlight: value-spec=70
