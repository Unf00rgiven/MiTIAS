AUTOSAR XML (schema 4-2-1)
standard types defined: boolean, sint8, uint16, uint8, uint32_DataConstr, uint8_DataConstr
package /ComponentTypes/DataTypeMappingSets
  data type mapping set ApMappingSet
    data-type-maps:
      application-data-type=AdtCharging, implementation-data-type=IdtCharging
      application-data-type=AdtIgnition, implementation-data-type=IdtIgnition
      application-data-type=AdtLock, implementation-data-type=IdtLock
      application-data-type=AdtSunlight, implementation-data-type=IdtSunlight
package /DataType/Semantics
  compu method CM_sig_AFSSwitch: phys=raw for raw 0..1
  compu method CM_sig_AmbientLightBrightness: phys=raw for raw 0..255
  compu method CM_sig_BatteryModeSwitch: phys=raw for raw 0..1
  compu method CM_sig_BatteryStatus: phys=raw for raw 0..255
  compu method CM_sig_currentSpeed: phys=raw for raw 0..255
  compu method CM_sig_CurrentSpeedSlider: phys=raw for raw 0..255
  compu method CM_sig_DisplaySpeed: phys=raw for raw 0..255
  compu method CM_sig_HighBeamSwitch: phys=raw for raw 0..1
  compu method CM_sig_Ignition: phys=raw for raw 0..1
  compu method CM_sig_LeftHAngle: phys=raw for raw -128..127
  compu method CM_sig_LeftLightLength: phys=raw for raw 0..255
  compu method CM_sig_LeftMode: phys=raw for raw 0..3
  compu method CM_sig_LeftVAngle: phys=raw for raw 0..255
  compu method CM_sig_Locking: phys=raw for raw 0..1
  compu method CM_sig_LongHealightSwitch: phys=raw for raw 0..1
  compu method CM_sig_RearInteriorLight: phys=raw for raw 0..1
  compu method CM_sig_RightHAngle: phys=raw for raw -128..127
  compu method CM_sig_RightLightLength: phys=raw for raw 0..255
  compu method CM_sig_RightMode: phys=raw for raw 0..3
  compu method CM_sig_RightVAngle: phys=raw for raw 0..255
  compu method CM_sig_SolarPanelSwitch: phys=raw for raw 0..1
  compu method CM_sig_SpeedLimit: phys=raw for raw 0..255
  compu method CM_sig_State_RearInteriorLight: phys=raw for raw 0..1
  compu method CM_sig_State_RearLeftDoor: phys=raw for raw 0..1
  compu method CM_sig_State_RearRightDoor: phys=raw for raw 0..1
  compu method CM_sig_SteeringWheelPosition: phys=raw for raw -128..127
  compu method CM_sig_SunlightPresence: phys=raw for raw 0..255
package /DataTypes
  6 x app type, all with sw-calibration-access=READ-ONLY:
    AdtBatteryStatus: category=VALUE
    AdtCharging: category=BOOLEAN
    AdtIgnition: category=BOOLEAN
    AdtLock: category=BOOLEAN
    AdtSpeedlimit: category=VALUE
    AdtSunlight: category=VALUE
  7 x impl type, all with category=TYPE_REFERENCE, type-emitter=RTE:
    IdtBatteryStatus: implementation-data-type=uint16
    IdtCharging: implementation-data-type=boolean
    IdtDioValueType: implementation-data-type=uint16
    IdtIgnition: implementation-data-type=boolean
    IdtLock: implementation-data-type=boolean
    IdtSpeedLimit: implementation-data-type=uint16
    IdtSunlight: implementation-data-type=uint16
package /DataTypes/CompuMethods
  compu method CmAFSState: 0=CMAFSSTATE_SWITCHOFF, 1=CMAFSSTATE_SWITCHON
  compu method CmLightMode: 0=CMLIGHTMODE_CITYMODE, 1=CMLIGHTMODE_COUNTRYMODE, 10=CMLIGHTMODE_MOTORWAYMODE, 11=CMLIGHTMODE_HIGHBEAM
package /Predefined_DEV/ImplementationDataTypes
  impl type NvM_RequestResultType: compu {0=NVM_REQ_OK, 1=NVM_REQ_NOT_OK, 2=NVM_REQ_PENDING, 3=NVM_REQ_INTEGRITY_FAILED, 4=NVM_REQ_BLOCK_SKIPPED, 5=NVM_REQ_NV_INVALIDATED, 6=NVM_REQ_CANCELED, 7=NVM_REQ_REDUNDANCY_FAILED, 8=NVM_REQ_RESTORED_FROM_ROM}, implementation-data-type=uint8
  impl type NvM_ServiceIdType: compu {6=NVM_READ_BLOCK, 7=NVM_WRITE_BLOCK, 8=NVM_RESTORE_BLOCK_DEFAULTS, 9=NVM_ERASE_BLOCK, 11=NVM_INVALIDATE_NV_BLOCK, 12=NVM_READ_ALL}, implementation-data-type=uint8
