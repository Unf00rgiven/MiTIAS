AUTOSAR XML (schema 4-0-3)
package /COM/VECTOR/CFG/WORKFLOW/SYSDESC/SYNC
  flat map FLATMAP
    46 x flat instance descriptor:
      RPortPrototype_001: upstream-reference=PpHighBeamSwitchReceive, ecu-extract-reference=PpHighBeamSwitchReceive
      RPortPrototype_002: upstream-reference=PpSteeringWheelPosition, ecu-extract-reference=PpSteeringWheelPosition
      DataMapping_006: upstream-reference=ECU_Composition.PpAmbientLightIn.DeAmbientLight, ecu-extract-reference=COMPOSITIONTYPE.PpAmbientLightIn.DeAmbientLight
      DataMapping_007: upstream-reference=ECU_Composition.PpVehicleSpeedIn.DeVehicleSpeed, ecu-extract-reference=COMPOSITIONTYPE.PpVehicleSpeedIn.DeVehicleSpeed
      ComponentPrototype_002: upstream-reference=ECU_Composition.CpCoApplication.CtSaBattery, ecu-extract-reference=COMPOSITIONTYPE.CtSaBattery
      ComponentPrototype_003: upstream-reference=ECU_Composition.CpCoApplication.CpIoHwAb, ecu-extract-reference=COMPOSITIONTYPE.CpIoHwAb
      ComponentPrototype_004: upstream-reference=ECU_Composition.CpCoApplication.CpSaSunlightPresence, ecu-extract-reference=COMPOSITIONTYPE.CpSaSunlightPresence
      ComponentPrototype_005: upstream-reference=ECU_Composition.CpCoApplication.CpSaSpeedLimit, ecu-extract-reference=COMPOSITIONTYPE.CpSaSpeedLimit
      ComponentPrototype_006: upstream-reference=ECU_Composition.CpCoApplication.CpSaSolarPanelControl, ecu-extract-reference=COMPOSITIONTYPE.CpSaSolarPanelControl
      ComponentPrototype_007: upstream-reference=ECU_Composition.CpCoApplication.CpSaLockControl, ecu-extract-reference=COMPOSITIONTYPE.CpSaLockControl
      ComponentPrototype_008: upstream-reference=ECU_Composition.CpCoApplication.CpSaEngineControl, ecu-extract-reference=COMPOSITIONTYPE.CpSaEngineControl
      ComponentPrototype_009: upstream-reference=ECU_Composition.CpCoApplication.CpApSEVMIController, ecu-extract-reference=COMPOSITIONTYPE.CpApSEVMIController
      AssemblySwConnector: ecu-extract-reference=CpSaEngineControlDPpIgnitionDCpApSEVMIControllerDPpIgnition
      AssemblySwConnector_001: ecu-extract-reference=CpSaLockControlDPpLockDCpApSEVMIControllerDPpLock
      AssemblySwConnector_002: ecu-extract-reference=CpSaSolarPanelControlDPpChargingDCpApSEVMIControllerDPpCharging
      AssemblySwConnector_003: ecu-extract-reference=CpSaSunlightPresenceDPpSunlightDCpApSEVMIControllerDPpSunlight
      ComponentPrototype_001: upstream-reference=ECU_Composition.CpCoApplication.CtSaBatteryModeManager, ecu-extract-reference=COMPOSITIONTYPE.CtSaBatteryModeManager
      PPortPrototype: upstream-reference=PpBatteryStatusOut, ecu-extract-reference=PpBatteryStatusOut
      PPortPrototype_001: upstream-reference=PpSpeedLimitOut, ecu-extract-reference=PpSpeedLimitOut
      RPortPrototype: upstream-reference=PpChargingIn, ecu-extract-reference=PpChargingIn
      RPortPrototype_003: upstream-reference=PpIgnitionIn, ecu-extract-reference=PpIgnitionIn
      RPortPrototype_004: upstream-reference=PpLockIn, ecu-extract-reference=PpLockIn
      RPortPrototype_005: upstream-reference=PpSunlightIn, ecu-extract-reference=PpSunlightIn
      AssemblySwConnector_004: ecu-extract-reference=CpApSEVMIControllerDPpSpeedLimitDCpSaSpeedLimitDPpSpeedLimit
      AssemblySwConnector_005: ecu-extract-reference=CpApSEVMIControllerDPpBatteryStatusDCtSaBatteryManagementDPpBatteryStatus
      AssemblySwConnector_006: ecu-extract-reference=CtIoHwAbDPpSpeedDCpApSEVMIControllerDPpSpeed
      DelegationSwConnector: ecu-extract-reference=PpSpeedLimitOutDDCpSaSpeedLimitDPpSpeedLimitOut
      DelegationSwConnector_001: ecu-extract-reference=PpBatteryStatusOutDDCtSaBatteryManagementDPpBatteryStatusOut
      DelegationSwConnector_002: ecu-extract-reference=PpSunlightInDDCpCoApplicationDPpSunlightIn
      DelegationSwConnector_003: ecu-extract-reference=PpLockInDDCpCoApplicationDPpLockIn
      DelegationSwConnector_004: ecu-extract-reference=PpIgnitionInDDCpCoApplicationDPpIgnitionIn
      DelegationSwConnector_005: ecu-extract-reference=PpChargingInDDCpCoApplicationDPpChargingIn
      RPortPrototype_006: upstream-reference=PpBatteryModeIn, ecu-extract-reference=PpBatteryModeIn
      AssemblySwConnector_007: ecu-extract-reference=CtSaBatteryModeManagerDPpBatteryModeDCpApSEVMIControllerDPpBatteryMode
      DelegationSwConnector_006: ecu-extract-reference=PpBatteryModeInDDCpCoApplicationDPpBatteryModeIn
      CpApSEVMIControllerNvMNotifyJobFinished_SnNvMPimDoorLockNvM_NvM_RpNotifyJobEnd_CpApSEVMIControllerSnNvMPimDoorLock: upstream-reference=COMPOSITIONTYPE.CpApSEVMIController.SnNvMPimDoorLock, ecu-extract-reference=CpApSEVMIControllerNvMNotifyJobFinished_SnNvMPimDoorLockNvM_NvM_RpNotifyJobEnd_CpApSEVMIControllerSnNvMPimDoorLock
      CpApSEVMIControllerNvMNotifyJobFinished_SnNvMPimDoorLockNvM_NvM_RpNotifyJobEnd_CpApSEVMIControllerSnNvMPimDoorLock_001: upstream-reference=COMPOSITIONTYPE.CpApSEVMIController.SnNvMPimDoorLock, ecu-extract-reference=CpApSEVMIControllerNvMNotifyJobFinished_SnNvMPimDoorLockNvM_NvM_RpNotifyJobEnd_CpApSEVMIControllerSnNvMPimDoorLock
      CpApSEVMIControllerPpNvMLockingCtApMySwcNvM_PS_CpApSEVMIControllerSnNvMPimDoorLock: upstream-reference=COMPOSITIONTYPE.CpApSEVMIController.SnNvMPimDoorLock, ecu-extract-reference=CpApSEVMIControllerPpNvMLockingCtApMySwcNvM_PS_CpApSEVMIControllerSnNvMPimDoorLock
      CpApSEVMIControllerPpNvMLockingCtApMySwcNvM_PS_CpApSEVMIControllerSnNvMPimDoorLock_001: upstream-reference=COMPOSITIONTYPE.CpApSEVMIController.SnNvMPimDoorLock, ecu-extract-reference=CpApSEVMIControllerPpNvMLockingCtApMySwcNvM_PS_CpApSEVMIControllerSnNvMPimDoorLock
      CpApSEVMIControllerSnNvMPimDoorLock: upstream-reference=COMPOSITIONTYPE.CpApSEVMIController.SnNvMPimDoorLock
      DataMapping: upstream-reference=ECU_Composition.PpChargingIn.DeCharging, ecu-extract-reference=COMPOSITIONTYPE.PpChargingIn.DeCharging
      DataMapping_001: upstream-reference=ECU_Composition.PpSpeedLimitOut.DeSpeedLimit, ecu-extract-reference=COMPOSITIONTYPE.PpSpeedLimitOut.DeSpeedLimit
      DataMapping_002: upstream-reference=ECU_Composition.PpSunlightIn.DeSunlight, ecu-extract-reference=COMPOSITIONTYPE.PpSunlightIn.DeSunlight
      DataMapping_003: upstream-reference=ECU_Composition.PpLockIn.DeLock, ecu-extract-reference=COMPOSITIONTYPE.PpLockIn.DeLock
      DataMapping_004: upstream-reference=ECU_Composition.PpBatteryStatusOut.DeBatteryStatus, ecu-extract-reference=COMPOSITIONTYPE.PpBatteryStatusOut.DeBatteryStatus
      DataMapping_005: upstream-reference=ECU_Composition.PpIgnitionIn.DeIgnition, ecu-extract-reference=COMPOSITIONTYPE.PpIgnitionIn.DeIgnition
